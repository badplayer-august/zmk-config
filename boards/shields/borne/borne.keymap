#include <behaviors.dtsi>
#include <dt-bindings/zmk/keys.h>

#include "zmk-helpers/helper.h"
#include "behaviors/num_word.dtsi"
#include "key-label.h"

 /*                                      60 KEY MATRIX / LAYOUT MAPPING

  ╭────────────────────────────┬────────────────────────────╮ ╭─────────────────────────────┬─────────────────────────────╮
  │  0   1   2   3   4   5     │      6   7   8   9  10  11 │ │ LN5 LN4 LN3 LN2 LN1 LN0     │     RN0 RN1 RN2 RN3 RN4 RN5 │
  │ 12  13  14  15  16  17  18 │ 19  20  21  22  23  24  25 │ │ LT5 LT4 LT3 LT2 LT1 LT0 LTE │ RTE RT0 RT1 RT2 RT3 RT4 RT5 │
  │ 26  27  28  29  30  31  32 │ 33  34  35  36  37  38  39 │ │ LM5 LM4 LM3 LM2 LM1 LM0 LME │ RME RM0 RM1 RM2 RM3 RM4 RM5 │
  │ 40  41  42  43  44  45  46 │ 47  48  49  50  51  52  53 │ │ LB5 LB4 LB3 LB2 LB1 LB0 LBE │ RBE RB0 RB1 RB2 RB3 RB4 RB5 │
  ╰───────────────╮ 54  55  56 │ 57  58  59 ╭───────────────╯ ╰───────────────╮ LH2 LH1 LH0 │ RH0 RH1 RH2 ╭───────────────╯
                  ╰────────────┴────────────╯                                 ╰─────────────┴─────────────╯                 */

#define KEYS_L \
  LN0 LN1 LN2 LN3 LN4 LN5 \
  LT0 LT1 LT2 LT3 LT4 LT5 LTE \
  LM0 LM1 LM2 LM3 LM4 LM5 LME  \
  LB0 LB1 LB2 LB3 LB4 LB5 LBE // left-hand keys

#define KEYS_R \
  RN0 RN1 RN2 RN3 RN4 RN5 \
  RT0 RT1 RT2 RT3 RT4 RT5 RTE \
  RM0 RM1 RM2 RM3 RM4 RM5 RME  \
  RB0 RB1 RB2 RB3 RB4 RB5 RBE // right-hand keys

#define THUMBS LH2 LH1 LH0 RH0 RH1 RH2

// layers
#define DEF 0
#define NHM 1
#define CAP 2
#define NUM 3
#define SYM 4
#define NAV 5
#define N60 6
#define FGT 7

// keys
#define ___ &trans
#define xxx &none

// config
#define RELEASE_AFTER_MS      900  // release after 0.9s
#define SLOW_TAPPING_TERM_MS  280 // for thumb
#define FAST_TAPPING_TERM_MS  200 // for other fingre
#define QUICK_TAP_MS          175 // repeat on tap-into-hold
#define REQUIRE_PRIOR_IDLE_MS 250

ZMK_APPLY_MATRIX_TRANSFORM(default_transform)

/ {
    behaviors {
        num_word: num_word {
            compatible = "zmk,behavior-auto-layer";
            #binding-cells = <1>;
            continue-list = <
              BACKSPACE DELETE
              COMMA DOT
              MINUS PLUS
              PERCENT HASH STAR SLASH BACKSLASH
              EXCL EQUAL
              AMPERSAND PIPE 
              LPAR RPAR LBKT RBKT LBRC RBRC LT GT
              UNDER AT
              CARET DOLLAR
            >;
            ignore-numbers;
        };
        cap_word: cap_word {
            compatible = "zmk,behavior-auto-layer";
            #binding-cells = <1>;
            continue-list = <
              BACKSPACE DELETE
              COMMA DOT
              MINUS PLUS
              PERCENT HASH STAR SLASH BACKSLASH
              EXCL EQUAL
              AMPERSAND PIPE 
              LPAR RPAR LBKT RBKT LBRC RBRC LT GT
              UNDER AT
              CARET DOLLAR
            >;
            ignore-alphas;
        };
    };
};

&sk {  // sticky-key config
    release-after-ms = <RELEASE_AFTER_MS>;
    quick-release;             // no double capitalization when rolling keys
};

&sl {  // sticky-layer config
    release-after-ms = <RELEASE_AFTER_MS>;
    quick-release;             // no double capitalization when rolling keys
    ignore-modifiers;
};

&lt {  // layer-tap config
    flavor = "balanced";
    tapping-term-ms = <FAST_TAPPING_TERM_MS>;
    quick-tap-ms = <QUICK_TAP_MS>;
};

// timeless home mod
ZMK_HOLD_TAP(hml,
    flavor = "balanced";
    tapping-term-ms = <SLOW_TAPPING_TERM_MS>;
    quick-tap-ms = <QUICK_TAP_MS>;                
    require-prior-idle-ms = <REQUIRE_PRIOR_IDLE_MS>;
    bindings = <&kp>, <&kp>;
    hold-trigger-key-positions = <KEYS_R THUMBS>;
    hold-trigger-on-release;             // delay positional check until key-release
)

ZMK_HOLD_TAP(hmr,
    flavor = "balanced";
    tapping-term-ms = <SLOW_TAPPING_TERM_MS>;
    quick-tap-ms = <QUICK_TAP_MS>;                // repeat on tap-into-hold
    require-prior-idle-ms = <REQUIRE_PRIOR_IDLE_MS>;
    bindings = <&kp>, <&kp>;
    hold-trigger-key-positions = <KEYS_L THUMBS>;
    hold-trigger-on-release;             // delay positional check until key-release
)

// momentary and sticky layer
ZMK_HOLD_TAP(msl,
    tapping-term-ms = <FAST_TAPPING_TERM_MS>;
    bindings = <&mo>, <&sl>;
)

// num_word and caps_word
// tap sticky: symbol layer; double tap: num dance; hold: navigation layer
ZMK_HOLD_TAP(rh2,
    flavor = "balanced";
    tapping-term-ms = <FAST_TAPPING_TERM_MS>;
    bindings = <&mo>, <&inner_rh2>;
)
ZMK_TAP_DANCE(inner_rh2,
    tapping-term-ms = <SLOW_TAPPING_TERM_MS>;
    bindings = <&sl NUM>, <&num_word NUM>;  // reverse this for sticky-num on single tap
)

// tap sticky: sticky shift; double tap: cap dance; hold: navigation layer
ZMK_HOLD_TAP(lh2,
    flavor = "balanced";
    tapping-term-ms = <FAST_TAPPING_TERM_MS>;
    bindings = <&mo>, <&inner_lh2>;
)
ZMK_TAP_DANCE(inner_lh2,
    tapping-term-ms = <SLOW_TAPPING_TERM_MS>;
    bindings = <&sk LSFT>, <&cap_word CAP>;  // reverse this for sticky-num on single tap
)

// tap: backspace; shift tap: delete
ZMK_MOD_MORPH(back_del,
    bindings = <&kp BACKSPACE>, <&kp DEL>;
    mods = <(MOD_LSFT|MOD_RSFT)>;
)

// cancel sticky layer
ZMK_HOLD_TAP(cl,
    flavor = "balanced";
    tapping-term-ms = <FAST_TAPPING_TERM_MS>;
    bindings = <&mo>, <&kp>;
)

ZMK_LAYER(default_layer,
    &kp GRAVE &kp N1      &kp N2      &kp N3      &kp N4      &kp N5                                &kp N6    &kp N7      &kp N8      &kp N9      &kp N0         &kp DEL
    &kp CAPS  &kp Q       &kp W       &kp E       &kp R       &kp T   &to DEF         &to NHM       &kp Y     &kp U       &kp I       &kp O       &kp P          &kp BSLH
    &kp ESC   &hml LALT A &hml LGUI S &hml LSFT D &hml LCTL F &kp G   &to FGT         &to N60       &kp H     &hmr RCTL J &hmr RSFT K &hmr RGUI L &hmr RALT SEMI &sl SYM
    &kp LCTRL &kp Z       &kp X       &kp C       &kp V       &kp B   &kp K_PP        &kp K_MUTE    &kp N     &kp M       &kp COMMA   &kp DOT     &kp FSLH       &kp LSFT
                                                  &lh2 NAV 0  &kp TAB &lt NUM SPACE   &lt SYM ENTER &back_del &rh2 NAV 0                                                 ,
    &inc_dec_kp K_SCROLL_UP K_SCROLL_DOWN
    &inc_dec_kp K_VOL_DN K_VOL_UP
)

ZMK_LAYER(no_home_mod_layer,
    ___ ___   ___   ___   ___   ___           ___ ___   ___   ___   ___      ___
    ___ ___   ___   ___   ___   ___ ___   ___ ___ ___   ___   ___   ___      ___
    ___ &kp A &kp S &kp D &kp F ___ ___   ___ ___ &kp J &kp K &kp K &kp SEMI ___
    ___ ___   ___   ___   ___   ___ ___   ___ ___ ___   ___   ___   ___      ___
                          ___   ___ ___   ___ ___ ___                           ,
    &inc_dec_kp UP DOWN
    &inc_dec_kp LEFT RIGHT
)

ZMK_LAYER(cap_layer,
    ___ ___             ___             ___             ___              ___                 ___       ___             ___             ___             ___            ___
    ___ &kp LS(Q)       &kp LS(W)       &kp LS(E)       &kp LS(R)        &kp LS(T) ___   ___ &kp LS(Y) &kp LS(U)       &kp LS(I)       &kp LS(O)       &kp LS(P)      ___
    ___ &hml LALT LS(A) &hml LGUI LS(S) &hml LSFT LS(D) &hml LCTL LS(F)  &kp LS(G) ___   ___ &kp LS(H) &hmr RCTL LS(J) &hmr RSFT LS(K) &hmr RGUI LS(L) &hmr RALT SEMI ___
    ___ &kp LS(Z)       &kp LS(X)       &kp LS(C)       &kp LS(V)        &kp LS(B) ___   ___ &kp LS(N) &kp LS(M)       ___             ___             ___            ___
                                                        &cl NAV K_CANCEL ___       ___   ___ ___       ___                                                               ,
    &inc_dec_kp UP DOWN
    &inc_dec_kp LEFT RIGHT
)

ZMK_LAYER(num_layer,
    ___       ___           ___            ___            ___           ___                 ___       ___          ___          ___          ___            ___
    &kp TAB   xxx           &kp LPAR       &kp RPAR       &kp GRAVE     &kp TILDE ___   ___ &kp MINUS &kp N7       &kp N8       &kp N9       &kp PERCENT    ___
    &kp SPACE &hml LALT xxx &hml LGUI LBKT &hml LSFT RBKT &hml LCTL DQT &kp SQT   ___   ___ &kp PLUS  &hmr RCTL N4 &hmr RSFT N5 &hmr RGUI N6 &hmr RALT STAR ___
    &kp COMMA &kp DOT       &kp LBRC       &kp RBRC       &kp UNDER     &kp AT    ___   ___ &kp N0    &kp N1       &kp N2       &kp N3       &kp SLASH      ___
                                                          ___           ___       ___   ___ ___       &cl NAV K_CANCEL                                         ,
    &inc_dec_kp UP DOWN
    &inc_dec_kp LEFT RIGHT
)

ZMK_LAYER(sym_layer,
    ___       ___           ___            ___            ___           ___                 ___       ___            ___             ___            ___            ___
    ___       xxx           &kp LPAR       &kp RPAR       &kp GRAVE     &kp TILDE ___   ___ &kp MINUS &kp AMPERSAND  &kp PIPE        &kp BACKSLASH  &kp PERCENT    &back_del
    ___       &hml LALT xxx &hml LGUI LBKT &hml LSFT RBKT &hml LCTL DQT &kp SQT   ___   ___ &kp PLUS  &hmr RCTL EXCL &hmr RSFT EQUAL &hmr RGUI HASH &hmr RALT STAR &kp ENTER
    &kp COMMA &kp DOT       &kp LBRC       &kp RBRC       &kp UNDER     &kp AT    ___   ___ &kp CARET &kp DOLLAR     &kp LT          &kp GT         &kp SLASH      ___
                                                          ___           ___       ___   ___ ___       ___                                                                   ,
    &inc_dec_kp UP DOWN
    &inc_dec_kp LEFT RIGHT
)

ZMK_LAYER(nav_layer,
    ___ ___           ___          ___          ___          ___               ___       ___       ___       ___       ___          ___
    ___ xxx           &kp F1       &kp F2       &kp F3       &kp F4  ___   ___ &kp PSCRN &kp RCTL  &kp RSFT  &kp RGUI  &kp RALT     ___
    ___ &hml LALT xxx &hml LGUI F5 &hml LSFT F6 &hml LCTL F7 &kp F8  ___   ___ &kp LEFT  &kp DOWN  &kp UP    &kp RIGHT &kp CAPS     ___
    ___ &kp K_CANCEL  &kp F9       &kp F10      &kp F11      &kp F12 ___   ___ &kp HOME  &kp PG_DN &kp PG_UP &kp END   &kp K_CANCEL ___
                                                ___          ___     ___   ___ ___       ___                                           ,
    &inc_dec_kp K_PREV K_NEXT
    &inc_dec_kp K_VOL_DN K_VOL_UP
)

ZMK_LAYER(normal60_layer,
    &kp GRAVE &kp N1 &kp N2 &kp N3 &kp N4   &kp N5                        &kp N6        &kp N7   &kp N8    &kp N9  &kp N0   &kp DEL
    &kp CAPS  &kp Q  &kp W  &kp E  &kp R    &kp T   &kp MINUS   &kp EQUAL &kp Y         &kp U    &kp I     &kp O   &kp P    &kp BSLH
    &kp ESC   &kp A  &kp S  &kp D  &kp F    &kp G   &kp LBRC    &kp RBRC  &kp H         &kp J    &kp K     &kp L   &kp SEMI &kp SQT
    &kp LCTRL &kp Z  &kp X  &kp C  &kp V    &kp B   &to DEF     &to FGT   &kp N         &kp M    &kp COMMA &kp DOT &kp FSLH &kp LSFT
                                   &kp LGUI &kp TAB &kp SPACE   &kp ENTER &kp BACKSPACE &kp LALT                                    ,
    &inc_dec_kp UP DOWN
    &inc_dec_kp LEFT RIGHT
)

ZMK_LAYER(fighting_game_layer,
    &kp GRAVE &kp N1 &kp N2 &kp N3 &kp N4 &kp N5                       &kp N6 &kp N7   &kp N8    &kp N9  &kp N0   &kp DEL
    &kp TAB   &kp Q  &kp W  &kp E  &kp R  &kp T  &kp MINUS   &kp EQUAL &kp Y  &kp U    &kp I     &kp O   &kp P    &kp BACKSPACE
    &kp ESC   &kp A  &kp S  &kp D  &kp F  &kp G  &kp LBRC    &kp RBRC  &kp H  &kp J    &kp K     &kp L   &kp SEMI &kp ENTER
    &kp N1    &kp Z  &kp X  &kp C  &kp V  &kp B  &to DEF     &to N60   &kp N  &kp M    &kp COMMA &kp DOT &kp FSLH &kp N6
                                   &kp N2 &kp N3 &kp SPACE   &kp SPACE &kp N4 &kp N5                                           ,
    &inc_dec_kp UP DOWN
    &inc_dec_kp LEFT RIGHT
)
