#include <physical_layouts.dtsi>

/ {
    layouts_borne_position_map: layouts_borne_position_map {
      compatible = "zmk,physical-layout-position-map";
      complete;
    };

    default_layout: default_layout {
        compatible = "zmk,physical-layout";
        display-name = "Default Layout";
        transform = <&default_transform>;
        kscan = <&kscan>;
    };
};

&layouts_borne_position_map {
    default_posmap {
        physical-layout = <&default_layout>;
        positions
            = < 0  1  2  3  4  5        6  7  8  9 10 11>
            , <12 13 14 15 16 17 18 19 20 21 22 23 24 25>
            , <26 27 28 29 30 31 32 33 34 35 36 37 38 39>
            , <40 41 42 43 44 45 46 47 48 49 50 51 52 53>
            , <            54 55 56 57 58 59            >;
    };
};

