## boards/shields/borne/Kconfig.defconfig
```kconfig
if SHIELD_BORNE_RIGHT

config ZMK_KEYBOARD_NAME
    default "borne"

config ZMK_SPLIT_ROLE_CENTRAL
    default y

endif # SHIELD_BORNE_RIGHT

if SHIELD_BORNE_LEFT || SHIELD_BORNE_RIGHT

if BUILD_OUTPUT_UF2

config BUILD_OUTPUT_UF2_USE_FLASH_BASE
    default y

config BUILD_OUTPUT_UF2_USE_FLASH_OFFSET
    default y

endif # BUILD_OUTPUT_UF2

config ZMK_SPLIT
    default y

config ZMK_SPLIT_WIRED
    default y

if USB

config USB_NRFX
    default y

config USB_DEVICE_STACK
    default y

endif # USB

endif # SHIELD_BORNE_LEFT || SHIELD_BORNE_RIGHT
```

## boards/stm32f401rc/stm32f401rc_zmk_defconfig
```kconfig
CONFIG_ARM_MPU=y

CONFIG_HW_STACK_PROTECTION=y

# Enable ZMK outputs
CONFIG_ZMK_USB=y
```
