/*
 * Copyright (c) 2020 The ZMK Contributors
 *
 * SPDX-License-Identifier: MIT
 */


#include <behaviors.dtsi>
#include <dt-bindings/zmk/keys.h>
#include <dt-bindings/zmk/bt.h>
#include <dt-bindings/zmk/ext_power.h>
#include <dt-bindings/zmk/outputs.h>
#include <dt-bindings/zmk/rgb.h>

#include "zmk-helpers/helper.h"
#include "zmk-helpers/key-labels/42.h"

/*                                      42 KEY MATRIX / LAYOUT MAPPING

  ╭────────────────────────┬────────────────────────╮ ╭─────────────────────────┬─────────────────────────╮
  │  0   1   2   3   4   5 │  6   7   8   9  10  11 │ │ LT5 LT4 LT3 LT2 LT1 LT0 │ RT0 RT1 RT2 RT3 RT4 RT5 │
  │ 12  13  14  15  16  17 │ 18  19  20  21  22  23 │ │ LM5 LM4 LM3 LM2 LM1 LM0 │ RM0 RM1 RM2 RM3 RM4 RM5 │
  │ 24  25  26  27  28  29 │ 30  31  32  33  34  35 │ │ LB5 LB4 LB3 LB2 LB1 LB0 │ RB0 RB1 RB2 RB3 RB4 RB5 │
  ╰───────────╮ 36  37  38 │ 39  40  41 ╭───────────╯ ╰───────────╮ LH2 LH1 LH0 │ RH0 RH1 RH2 ╭───────────╯
              ╰────────────┴────────────╯                         ╰─────────────┴─────────────╯             */

// layers
#define DEF 0
#define CAP 1
#define NUM 2
#define SYM 3
#define NAV 4
#define CTL 5
#define FGT 6

// keys
#define ___ &trans
#define xxx &none
#define POWER(act) &ext_power act
#define RGB(act) &rgb_ug act
#define CANCEL K_CANCEL

// config
#define RELEASE_AFTER_MS      900  // release after 0.9s
#define SLOW_TAPPING_TERM_MS  280 // for thumb
#define FAST_TAPPING_TERM_MS  200 // for other fingre
#define QUICK_TAP_MS          175 // repeat on tap-into-hold
#define REQUIRE_PRIOR_IDLE_MS 250

ZMK_APPLY_MATRIX_TRANSFORM(default_transform)

/ {
    behaviors {
        num_word: num_word {
            compatible = "zmk,behavior-auto-layer";
            #binding-cells = <1>;
            continue-list = <
              BACKSPACE DELETE
              COMMA DOT
              MINUS PLUS
              PERCENT HASH STAR SLASH BACKSLASH
              EXCL EQUAL
              AMPERSAND PIPE 
              LPAR RPAR LBKT RBKT LBRC RBRC LT GT
              UNDER AT
              CARET DOLLAR
            >;
            ignore-numbers;
        };
        cap_word: cap_word {
            compatible = "zmk,behavior-auto-layer";
            #binding-cells = <1>;
            continue-list = <
              BACKSPACE DELETE
              COMMA DOT
              MINUS PLUS
              PERCENT HASH STAR SLASH BACKSLASH
              EXCL EQUAL
              AMPERSAND PIPE 
              LPAR RPAR LBKT RBKT LBRC RBRC LT GT
              UNDER AT
              CARET DOLLAR
            >;
            ignore-alphas;
        };
    };
};

// global setting
&sk {  // sticky-key config
    release-after-ms = <RELEASE_AFTER_MS>;
    quick-release;             // no double capitalization when rolling keys
};

&sl {  // sticky-layer config
    release-after-ms = <RELEASE_AFTER_MS>;
    quick-release;             // no double capitalization when rolling keys
    ignore-modifiers;
};

&lt {  // layer-tap config
    flavor = "balanced";
    tapping-term-ms = <FAST_TAPPING_TERM_MS>;
    quick-tap-ms = <QUICK_TAP_MS>;
};

// timeless home mod
ZMK_HOLD_TAP(hml,
    flavor = "balanced";
    tapping-term-ms = <SLOW_TAPPING_TERM_MS>;
    quick-tap-ms = <QUICK_TAP_MS>;                
    require-prior-idle-ms = <REQUIRE_PRIOR_IDLE_MS>;
    bindings = <&kp>, <&kp>;
    hold-trigger-key-positions = <KEYS_R THUMBS>;
    hold-trigger-on-release;             // delay positional check until key-release
)

ZMK_HOLD_TAP(hmr,
    flavor = "balanced";
    tapping-term-ms = <SLOW_TAPPING_TERM_MS>;
    quick-tap-ms = <QUICK_TAP_MS>;                // repeat on tap-into-hold
    require-prior-idle-ms = <REQUIRE_PRIOR_IDLE_MS>;
    bindings = <&kp>, <&kp>;
    hold-trigger-key-positions = <KEYS_L THUMBS>;
    hold-trigger-on-release;             // delay positional check until key-release
)

// smart bluetooth
#define BTC(dev) &bt_con dev dev
ZMK_MACRO_ONE_PARAM(bt_clr,
    bindings=
        <&macro_param_1to2>,
        <&bt BT_SEL MACRO_PLACEHOLDER>,
        <&bt BT_CLR>;
)

ZMK_MACRO_ONE_PARAM(bt_sel,
    bindings=
        <&macro_param_1to2>,
        <&bt BT_SEL MACRO_PLACEHOLDER>;
)

ZMK_HOLD_TAP(bt_con,
    flavor = "tap-preferred";
    tapping-term-ms = <1000>;           // hold 1 sec to clear device
    bindings = <&bt_clr>, <&bt_sel>;
)

ZMK_HOLD_TAP(ctl_bt,
    flavor = "balanced";
    tapping-term-ms = <200>;
    bindings = <&mo>, <&bt_sel>;
)

// momentary and sticky layer
ZMK_HOLD_TAP(msl,
    tapping-term-ms = <FAST_TAPPING_TERM_MS>;
    bindings = <&mo>, <&sl>;
)

// num_word and caps_word
// tap sticky: symbol layer; double tap: num dance; hold: navigation layer
ZMK_HOLD_TAP(rh2,
    flavor = "balanced";
    tapping-term-ms = <FAST_TAPPING_TERM_MS>;
    bindings = <&mo>, <&inner_rh2>;
)
ZMK_TAP_DANCE(inner_rh2,
    tapping-term-ms = <SLOW_TAPPING_TERM_MS>;
    bindings = <&sl NUM>, <&num_word NUM>;  // reverse this for sticky-num on single tap
)

// tap sticky: sticky shift; double tap: cap dance; hold: navigation layer
ZMK_HOLD_TAP(lh2,
    flavor = "balanced";
    tapping-term-ms = <FAST_TAPPING_TERM_MS>;
    bindings = <&mo>, <&inner_lh2>;
)
ZMK_TAP_DANCE(inner_lh2,
    tapping-term-ms = <SLOW_TAPPING_TERM_MS>;
    bindings = <&sk LSFT>, <&cap_word CAP>;  // reverse this for sticky-num on single tap
)

// tap: backspace; shift tap: delete
ZMK_MOD_MORPH(back_del,
    bindings = <&kp BACKSPACE>, <&kp DEL>;
    mods = <(MOD_LSFT|MOD_RSFT)>;
)

// cancel sticky layer
ZMK_HOLD_TAP(cl,
    flavor = "balanced";
    tapping-term-ms = <FAST_TAPPING_TERM_MS>;
    bindings = <&mo>, <&kp>;
)

// tap dance:
ZMK_TAP_DANCE(lsft_fgt,
    tapping-term-ms = <280>;
    bindings = <&kp LSFT>, <&to FGT>;
)
ZMK_TAP_DANCE(n1_def,
    tapping-term-ms = <280>;
    bindings = <&kp N1>, <&to DEF>;
)

// macro
// ZMK_HOLD_TAP(lctl_clr,
//     flavor = "balanced";
//     tapping-term-ms = <200>;
//     bindings = <&kp>, <&inner_lctl_clr>;
// )
// ZMK_MACRO(inner_lctl_clr,
//     bindings=
//         <&kp K_CANCEL>,
//         <&kp LCTL>;
// )

// combo
/* ZMK_COMBO(esc, &kp ESC, LH0 RH0, DEF NUM SYM, 100) */
/* ZMK_COMBO(toggle_caplock, &kp CAPS, LH1 RH1, DEF NUM SYM, 100) */
/* ZMK_COMBO(to_def, &to DEF, LH2 RH2 LM5, ALL, 100) */
/* ZMK_COMBO(to_fight_gam, &to FGT, LH2 RH2 RM5, ALL, 100) */

ZMK_LAYER(default_layer,
     // ╭───────────────┬───────────────┬───────────────┬───────────────┬───────────────┬───────────────╮   ╭───────────────┬───────────────┬───────────────┬───────────────┬───────────────┬───────────────╮
          &ctl_bt CTL 0   &kp Q           &kp W           &kp E           &kp R           &kp T               &kp Y           &kp U           &kp I           &kp O           &kp P           &ctl_bt CTL 1
     // ├───────────────┼───────────────┼───────────────┼───────────────┼───────────────┼───────────────┤   ├───────────────┼───────────────┼───────────────┼───────────────┼───────────────┼───────────────┤
          &kp ESC         &hml LALT A     &hml LGUI S     &hml LSFT D    &hml LCTL F      &kp G               &kp H           &hmr RCTL J    &hmr RSFT K      &hmr RGUI L     &hmr RALT SEMI  &sl SYM
     // ├───────────────┼───────────────┼───────────────┼───────────────┼───────────────┼───────────────┤   ├───────────────┼───────────────┼───────────────┼───────────────┼───────────────┼───────────────┤
          &kp LCTL        &kp Z           &kp X           &kp C           &kp V           &kp B               &kp N           &kp M           &kp COMMA       &kp DOT         &kp SLASH       &lsft_fgt
     // ╰───────────────────────────────────────────────┼───────────────┼───────────────┼───────────────┤   ├───────────────┼───────────────┼───────────────┼───────────────────────────────────────────────╯
                                                          &lh2 NAV 0      &kp TAB         &lt NUM SPACE       &lt SYM ENTER   &back_del       &rh2 NAV 0
     //                                                 ╰───────────────┴───────────────┴───────────────╯   ╰───────────────┴───────────────┴───────────────╯
)

ZMK_LAYER(cap_layer,
     // ╭───────────────┬───────────────┬───────────────┬───────────────┬───────────────┬───────────────╮   ╭───────────────┬───────────────┬───────────────┬───────────────┬───────────────┬───────────────╮
          ___             &kp LS(Q)       &kp LS(W)       &kp LS(E)       &kp LS(R)       &kp LS(T)           &kp LS(Y)       &kp LS(U)       &kp LS(I)       &kp LS(O)       &kp LS(P)       ___
     // ├───────────────┼───────────────┼───────────────┼───────────────┼───────────────┼───────────────┤   ├───────────────┼───────────────┼───────────────┼───────────────┼───────────────┼───────────────┤
          ___             &hml LALT LS(A) &hml LGUI LS(S) &hml LSFT LS(D) &hml LCTL LS(F) &kp LS(G)           &kp LS(H)       &hmr RCTL LS(J) &hmr RSFT LS(K) &hmr RGUI LS(L) &hmr RALT SEMI  ___
     // ├───────────────┼───────────────┼───────────────┼───────────────┼───────────────┼───────────────┤   ├───────────────┼───────────────┼───────────────┼───────────────┼───────────────┼───────────────┤
          ___             &kp LS(Z)       &kp LS(X)       &kp LS(C)       &kp LS(V)       &kp LS(B)           &kp LS(N)       &kp LS(M)       &kp COMMA       &kp DOT         &kp SLASH       ___
     // ╰───────────────────────────────────────────────┼───────────────┼───────────────┼───────────────┤   ├───────────────┼───────────────┼───────────────┼───────────────────────────────────────────────╯
                                                          &cl NAV CANCEL  ___             ___                 ___             ___             ___
     //                                                 ╰───────────────┴───────────────┴───────────────╯   ╰───────────────┴───────────────┴───────────────╯
)

ZMK_LAYER(num_layer,
     // ╭───────────────┬───────────────┬───────────────┬───────────────┬───────────────┬───────────────╮   ╭───────────────┬───────────────┬───────────────┬───────────────┬───────────────┬───────────────╮
          &kp TAB         xxx             &kp LPAR        &kp RPAR        &kp GRAVE       &kp TILDE           &kp MINUS       &kp N7          &kp N8          &kp N9          &kp PERCENT     ___
     // ├───────────────┼───────────────┼───────────────┼───────────────┼───────────────┼───────────────┤   ├───────────────┼───────────────┼───────────────┼───────────────┼───────────────┼───────────────┤
          &kp SPACE       &hml LALT xxx   &hml LGUI LBKT  &hml LSFT RBKT  &hml LCTL DQT   &kp SQT             &kp PLUS        &hmr RCTL N4    &hmr RSFT N5    &hmr RGUI N6    &hmr RALT STAR  ___
     // ├───────────────┼───────────────┼───────────────┼───────────────┼───────────────┼───────────────┤   ├───────────────┼───────────────┼───────────────┼───────────────┼───────────────┼───────────────┤
          &kp COMMA       &kp DOT         &kp LBRC        &kp RBRC        &kp UNDER       &kp AT              &kp N0          &kp N1          &kp N2          &kp N3          &kp SLASH       ___
     // ╰───────────────────────────────────────────────┼───────────────┼───────────────┼───────────────┤   ├───────────────┼───────────────┼───────────────┼───────────────────────────────────────────────╯
                                                          ___             ___             ___                 ___             ___             &cl NAV CANCEL
     //                                                 ╰───────────────┴───────────────┴───────────────╯   ╰───────────────┴───────────────┴───────────────╯
)

ZMK_LAYER(sym_layer,
     // ╭───────────────┬───────────────┬───────────────┬───────────────┬───────────────┬───────────────╮   ╭───────────────┬───────────────┬───────────────┬───────────────┬───────────────┬───────────────╮
          ___             xxx             &kp LPAR        &kp RPAR        &kp GRAVE       &kp TILDE           &kp MINUS       &kp AMPERSAND   &kp PIPE        &kp BACKSLASH   &kp PERCENT     &back_del
     // ├───────────────┼───────────────┼───────────────┼───────────────┼───────────────┼───────────────┤   ├───────────────┼───────────────┼───────────────┼───────────────┼───────────────┼───────────────┤
          ___             &hml LALT xxx   &hml LGUI LBKT  &hml LSFT RBKT  &hml LCTL DQT   &kp SQT             &kp PLUS        &hmr RCTL EXCL  &hmr RSFT EQUAL &hmr RGUI HASH  &hmr RALT STAR  &kp ENTER
     // ├───────────────┼───────────────┼───────────────┼───────────────┼───────────────┼───────────────┤   ├───────────────┼───────────────┼───────────────┼───────────────┼───────────────┼───────────────┤
          &kp COMMA       &kp DOT         &kp LBRC        &kp RBRC        &kp UNDER       &kp AT              &kp CARET       &kp DOLLAR      &kp LT          &kp GT          &kp SLASH       ___
     // ╰───────────────────────────────────────────────┼───────────────┼───────────────┼───────────────┤   ├───────────────┼───────────────┼───────────────┼───────────────────────────────────────────────╯
                                                          ___             ___             ___                 ___             ___             ___
     //                                                 ╰───────────────┴───────────────┴───────────────╯   ╰───────────────┴───────────────┴───────────────╯
)

ZMK_LAYER(nav_layer,
     // ╭───────────────┬───────────────┬───────────────┬───────────────┬───────────────┬───────────────╮   ╭───────────────┬───────────────┬───────────────┬───────────────┬───────────────┬───────────────╮
          ___             xxx             &kp F1          &kp F2          &kp F3          &kp F4              &kp PSCRN       &kp RCTL        &kp RSFT        &kp RGUI        &kp RALT        ___
     // ├───────────────┼───────────────┼───────────────┼───────────────┼───────────────┼───────────────┤   ├───────────────┼───────────────┼───────────────┼───────────────┼───────────────┼───────────────┤
          ___             &hml LALT xxx   &hml LGUI F5    &hml LSFT F6    &hml LCTL F7    &kp F8              &kp LEFT        &kp DOWN        &kp UP          &kp RIGHT       &kp CAPS        ___
     // ├───────────────┼───────────────┼───────────────┼───────────────┼───────────────┼───────────────┤   ├───────────────┼───────────────┼───────────────┼───────────────┼───────────────┼───────────────┤
          ___             &kp K_CANCEL    &kp F9          &kp F10         &kp F11         &kp F12             &kp HOME        &kp PG_DN       &kp PG_UP       &kp END         &kp K_CANCEL    ___
     // ╰───────────────────────────────────────────────┼───────────────┼───────────────┼───────────────┤   ├───────────────┼───────────────┼───────────────┼───────────────────────────────────────────────╯
                                                          ___             ___             ___                 ___             ___             ___
     //                                                 ╰───────────────┴───────────────┴───────────────╯   ╰───────────────┴───────────────┴───────────────╯
)

ZMK_LAYER(ctl_layer,
     // ╭───────────────┬───────────────┬───────────────┬───────────────┬───────────────┬───────────────╮   ╭───────────────┬───────────────┬───────────────┬───────────────┬───────────────┬───────────────╮
          ___             xxx             xxx             xxx             xxx             xxx                 xxx             xxx             xxx             xxx             xxx             ___
     // ├───────────────┼───────────────┼───────────────┼───────────────┼───────────────┼───────────────┤   ├───────────────┼───────────────┼───────────────┼───────────────┼───────────────┼───────────────┤
          &bootloader     BTC(0)          BTC(1)          BTC(2)          BTC(3)          BTC(4)              xxx             xxx             xxx             xxx             xxx             &bootloader
     // ├───────────────┼───────────────┼───────────────┼───────────────┼───────────────┼───────────────┤   ├───────────────┼───────────────┼───────────────┼───────────────┼───────────────┼───────────────┤
          &sys_reset      xxx             POWER(EP_ON)    POWER(EP_OFF)   &out OUT_USB    &out OUT_BLE        xxx             xxx             xxx             xxx             xxx             &sys_reset
     // ╰───────────────────────────────────────────────┼───────────────┼───────────────┼───────────────┤   ├───────────────┼───────────────┼───────────────┼───────────────────────────────────────────────╯
                                                          ___             ___             ___                 ___             ___             ___
     //                                                 ╰───────────────┴───────────────┴───────────────╯   ╰───────────────┴───────────────┴───────────────╯
)

ZMK_LAYER(fighting_game_layer,
     // ╭───────────────┬───────────────┬───────────────┬───────────────┬───────────────┬───────────────╮   ╭───────────────┬───────────────┬───────────────┬───────────────┬───────────────┬───────────────╮
          &kp TAB         &kp T           &kp Q           &kp W           &kp E           &kp R               &kp Y           &kp U           &kp I           &kp O           &kp P           &kp BACKSPACE
     // ├───────────────┼───────────────┼───────────────┼───────────────┼───────────────┼───────────────┤   ├───────────────┼───────────────┼───────────────┼───────────────┼───────────────┼───────────────┤
          &kp ESC         &kp G           &kp A           &kp S           &kp D           &kp F               &kp H           &kp J           &kp K           &kp L           &kp SEMI        &kp ENTER
     // ├───────────────┼───────────────┼───────────────┼───────────────┼───────────────┼───────────────┤   ├───────────────┼───────────────┼───────────────┼───────────────┼───────────────┼───────────────┤
          &n1_def         &kp B           &kp Z           &kp X           &kp C           &kp V               &kp N           &kp M           &kp COMMA       &kp DOT         &kp SLASH       &kp N6
     // ╰───────────────┼───────────────────────────────────────────────┼───────────────┼───────────────┤   ├───────────────┼───────────────┼───────────────┼───────────────────────────────────────────────╯
                                                          &kp N2          &kp N3          &kp SPACE           &kp SPACE       &kp N4          &kp N5
     //                                                 ╰───────────────┴───────────────┴───────────────╯   ╰───────────────┴───────────────┴───────────────╯
)

// ZMK_LAYER(layer,
//      // ╭───────────────┬───────────────┬───────────────┬───────────────┬───────────────┬───────────────╮   ╭───────────────┬───────────────┬───────────────┬───────────────┬───────────────┬───────────────╮
//           ___             ___             ___             ___             ___             ___                 ___             ___             ___             ___             ___             ___
//      // ├───────────────┼───────────────┼───────────────┼───────────────┼───────────────┼───────────────┤   ├───────────────┼───────────────┼───────────────┼───────────────┼───────────────┼───────────────┤
//           ___             ___             ___             ___             ___             ___                 ___             ___             ___             ___             ___             ___
//      // ├───────────────┼───────────────┼───────────────┼───────────────┼───────────────┼───────────────┤   ├───────────────┼───────────────┼───────────────┼───────────────┼───────────────┼───────────────┤
//           ___             ___             ___             ___             ___             ___                 ___             ___             ___             ___             ___             ___
//      // ╰───────────────────────────────────────────────┼───────────────┼───────────────┼───────────────┤   ├───────────────┼───────────────┼───────────────┼───────────────────────────────────────────────╯
//                                                           ___             ___             ___                 ___             ___             ___
//      //                                                 ╰───────────────┴───────────────┴───────────────╯   ╰───────────────┴───────────────┴───────────────╯
// )
