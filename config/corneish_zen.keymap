/*
 * Copyright (c) 2020 The ZMK Contributors
 *
 * SPDX-License-Identifier: MIT
 */

#include <behaviors.dtsi>
#include <dt-bindings/zmk/keys.h>
#include <dt-bindings/zmk/mouse.h>
#include <dt-bindings/zmk/bt.h>
#include <dt-bindings/zmk/ext_power.h>
#include <dt-bindings/zmk/outputs.h>
#include <dt-bindings/zmk/rgb.h>

#include "zmk-helpers/helper.h"
#include "zmk-helpers/key-labels/42.h"
#include "behaviors/num_word.dtsi"

/*                                      42 KEY MATRIX / LAYOUT MAPPING

  ╭────────────────────────┬────────────────────────╮ ╭─────────────────────────┬─────────────────────────╮
  │  0   1   2   3   4   5 │  6   7   8   9  10  11 │ │ LT5 LT4 LT3 LT2 LT1 LT0 │ RT0 RT1 RT2 RT3 RT4 RT5 │
  │ 12  13  14  15  16  17 │ 18  19  20  21  22  23 │ │ LM5 LM4 LM3 LM2 LM1 LM0 │ RM0 RM1 RM2 RM3 RM4 RM5 │
  │ 24  25  26  27  28  29 │ 30  31  32  33  34  35 │ │ LB5 LB4 LB3 LB2 LB1 LB0 │ RB0 RB1 RB2 RB3 RB4 RB5 │
  ╰───────────╮ 36  37  38 │ 39  40  41 ╭───────────╯ ╰───────────╮ LH2 LH1 LH0 │ RH0 RH1 RH2 ╭───────────╯
              ╰────────────┴────────────╯                         ╰─────────────┴─────────────╯             */

#define KEYS_L LT0 LT1 LT2 LT3 LT4 LT5 LM0 LM1 LM2 LM3 LM4 LM5 LB0 LB1 LB2 LB3 LB4 LB5  // left-hand keys
#define KEYS_R RT0 RT1 RT2 RT3 RT4 RT5 RM0 RM1 RM2 RM3 RM4 RM5 RB0 RB1 RB2 RB3 RB4 RB5  // right-hand keys
#define THUMBS LH2 LH1 LH0 RH0 RH1 RH2

// layers
#define DEF 0
#define NUM 1
#define SYM 2
#define NAV 3
#define CTL 4
#define GAM 5
#define FGT 6

#define ___ &trans
#define xxx &none
#define POWER(act) &ext_power act
#define RGB(act) &rgb_ug act

ZMK_APPLY_MATRIX_TRANSFORM(default_transform)

// global setting
&sk {  // sticky-key config
    release-after-ms = <900>;  // release after 0.9s
    quick-release;             // no double capitalization when rolling keys
};

&sl {  // sticky-layer config
    release-after-ms = <900>;  // release after 0.9s
    quick-release;             // no double capitalization when rolling keys
    ignore-modifiers;
};

&lt {  // layer-tap config
    flavor = "balanced";
    tapping-term-ms = <200>;
    quick-tap-ms = <175>;
};

// timeless home mod
ZMK_HOLD_TAP(hml,
    flavor = "balanced";
    tapping-term-ms = <280>;
    quick-tap-ms = <175>;                // repeat on tap-into-hold
    require-prior-idle-ms = <250>;
    bindings = <&kp>, <&kp>;
    hold-trigger-key-positions = <KEYS_R THUMBS>;
    hold-trigger-on-release;             // delay positional check until key-release
)

ZMK_HOLD_TAP(hmr,
    flavor = "balanced";
    tapping-term-ms = <280>;
    quick-tap-ms = <175>;                // repeat on tap-into-hold
    require-prior-idle-ms = <250>;
    bindings = <&kp>, <&kp>;
    hold-trigger-key-positions = <KEYS_L THUMBS>;
    hold-trigger-on-release;             // delay positional check until key-release
)

// smart bluetooth
#define BT_CON(dev) &bt_con dev dev
ZMK_MACRO_ONE_PARAM(bt_clr,
    bindings=
        <&macro_param_1to2>,
        <&bt BT_SEL MACRO_PLACEHOLDER>,
        <&bt BT_CLR>;
)

ZMK_MACRO_ONE_PARAM(bt_sel,
    bindings=
        <&macro_param_1to2>,
        <&bt BT_SEL MACRO_PLACEHOLDER>;
)

ZMK_HOLD_TAP(bt_con,
    flavor = "tap-preferred";
    tapping-term-ms = <1000>;           // hold 1 sec to clear device
    bindings = <&bt_clr>, <&bt_sel>;
)

// momentary and sticky layer
ZMK_HOLD_TAP(msl,
    tapping-term-ms = <200>;
    bindings = <&mo>, <&sl>;
)

// num_word and caps_word
// tap sticky: symbol layer; double tap: num dance; hold: navigation layer
ZMK_HOLD_TAP(rh2,
    flavor = "balanced";
    tapping-term-ms = <200>;
    bindings = <&mo>, <&inner_rh2>;
)
ZMK_TAP_DANCE(inner_rh2,
    tapping-term-ms = <280>;
    bindings = <&sl NUM>, <&num_word NUM>;  // reverse this for sticky-num on single tap
)

// tap sticky: sticky shift; double tap: cap dance; hold: navigation layer
ZMK_HOLD_TAP(lh2,
    flavor = "balanced";
    tapping-term-ms = <200>;
    bindings = <&mo>, <&inner_lh2>;
)
ZMK_TAP_DANCE(inner_lh2,
    tapping-term-ms = <280>;
    bindings = <&sk LSHFT>, <&caps_word>;  // reverse this for sticky-num on single tap
)
ZMK_MOD_MORPH(del_cancel, // cancel cap dance
    bindings = <&kp DEL>, <&kp K_CANCEL>;
    mods = <(MOD_LSFT|MOD_RSFT)>;
)

// tap: backspace; shift tap: delete
ZMK_MOD_MORPH(back_del,
    bindings = <&kp BACKSPACE>, <&kp DEL>;
    mods = <(MOD_LSFT|MOD_RSFT)>;
)

// combo
ZMK_COMBO(esc, &kp ESC, LH0 RH0, DEF NUM SYM, 100)
ZMK_COMBO(toggle_caplock, &kp CAPS, LH1 RH1, DEF NUM SYM, 100)
ZMK_COMBO(to_def, &to DEF, LH2 RH2 LM5, ALL, 100)
ZMK_COMBO(to_gam, &to GAM, LH2 RH2 LB5, ALL, 100)
ZMK_COMBO(to_fight_gam, &to FGT, LH2 RH2 RM5, ALL, 100)

ZMK_LAYER(default_layer,
     // ╭───────────────┬───────────────┬───────────────┬───────────────┬───────────────┬───────────────╮   ╭───────────────┬───────────────┬───────────────┬───────────────┬───────────────┬───────────────╮
          &mo CTL         &kp Q           &kp W           &kp E           &kp R           &kp T               &kp Y           &kp U           &kp I           &kp O           &kp P           &mo CTL
     // ├───────────────┼───────────────┼───────────────┼───────────────┼───────────────┼───────────────┤   ├───────────────┼───────────────┼───────────────┼───────────────┼───────────────┼───────────────┤
          &kp ESC         &hml LALT A     &hml LGUI S     &hml LSHFT D    &hml LCTRL F    &kp G               &kp H           &hmr RCTRL J    &hmr RSHFT K    &hmr RGUI L     &hmr RALT SEMI  &sl SYM
     // ├───────────────┼───────────────┼───────────────┼───────────────┼───────────────┼───────────────┤   ├───────────────┼───────────────┼───────────────┼───────────────┼───────────────┼───────────────┤
          &kp K_CANCEL    &kp Z           &kp X           &kp C           &kp V           &kp B               &kp N           &kp M           &kp COMMA       &kp DOT         &kp SLASH       &kp K_CANCEL
     // ╰───────────────────────────────────────────────┼───────────────┼───────────────┼───────────────┤   ├───────────────┼───────────────┼───────────────┼───────────────────────────────────────────────╯
                                                          &lh2 NAV 0      &kp TAB         &lt NUM SPACE       &lt SYM ENTER   &back_del       &rh2 NAV 0
     //                                                 ╰───────────────┴───────────────┴───────────────╯   ╰───────────────┴───────────────┴───────────────╯
)

ZMK_LAYER(num_layer,
     // ╭───────────────┬───────────────┬───────────────┬───────────────┬───────────────┬───────────────╮   ╭───────────────┬───────────────┬───────────────┬───────────────┬───────────────┬───────────────╮
          ___             ___             ___             ___             ___             ___                 &kp MINUS       &kp N7          &kp N8          &kp N9          &kp PERCENT     ___
     // ├───────────────┼───────────────┼───────────────┼───────────────┼───────────────┼───────────────┤   ├───────────────┼───────────────┼───────────────┼───────────────┼───────────────┼───────────────┤
          ___             &kp LALT        &kp LGUI        &kp LSHFT       &kp LCTRL       ___                 &kp PLUS        &kp N4          &kp N5          &kp N6          &kp ASTERISK    ___
     // ├───────────────┼───────────────┼───────────────┼───────────────┼───────────────┼───────────────┤   ├───────────────┼───────────────┼───────────────┼───────────────┼───────────────┼───────────────┤
          ___             ___             ___             ___             ___             ___                 &kp N0          &kp N1          &kp N2          &kp N3          ___             ___
     // ╰───────────────────────────────────────────────┼───────────────┼───────────────┼───────────────┤   ├───────────────┼───────────────┼───────────────┼───────────────────────────────────────────────╯
                                                          ___             ___             ___                 ___             ___             ___
     //                                                 ╰───────────────┴───────────────┴───────────────╯   ╰───────────────┴───────────────┴───────────────╯
)

ZMK_LAYER(sym_layer,
     // ╭───────────────┬───────────────┬───────────────┬───────────────┬───────────────┬───────────────╮   ╭───────────────┬───────────────┬───────────────┬───────────────┬───────────────┬───────────────╮
          ___             ___             &kp LPAR        &kp RPAR        &kp GRAVE       &kp TILDE           &kp MINUS       &kp AMPERSAND   &kp PIPE        &kp BACKSLASH   &kp PERCENT     ___
     // ├───────────────┼───────────────┼───────────────┼───────────────┼───────────────┼───────────────┤   ├───────────────┼───────────────┼───────────────┼───────────────┼───────────────┼───────────────┤
          ___             ___             &kp LBKT        &kp RBKT        &kp DQT         &kp SQT             &kp PLUS        &kp EXCL        &kp EQUAL       &kp HASH        &kp ASTERISK    ___
     // ├───────────────┼───────────────┼───────────────┼───────────────┼───────────────┼───────────────┤   ├───────────────┼───────────────┼───────────────┼───────────────┼───────────────┼───────────────┤
          ___             ___             &kp LBRC        &kp RBRC        &kp UNDER       &kp AT              &kp CARET       &kp DOLLAR      &kp COMMA       &kp DOT         ___             ___
     // ╰───────────────────────────────────────────────┼───────────────┼───────────────┼───────────────┤   ├───────────────┼───────────────┼───────────────┼───────────────────────────────────────────────╯
                                                          ___             ___             ___                 ___             ___             ___
     //                                                 ╰───────────────┴───────────────┴───────────────╯   ╰───────────────┴───────────────┴───────────────╯
)

ZMK_LAYER(nav_layer,
     // ╭───────────────┬───────────────┬───────────────┬───────────────┬───────────────┬───────────────╮   ╭───────────────┬───────────────┬───────────────┬───────────────┬───────────────┬───────────────╮
          ___             ___             &kp F1          &kp F2          &kp F3          &kp F4              &kp PSCRN       &key_repeat     &mkp MB1        &mkp MB2        &mkp MB3        ___
     // ├───────────────┼───────────────┼───────────────┼───────────────┼───────────────┼───────────────┤   ├───────────────┼───────────────┼───────────────┼───────────────┼───────────────┼───────────────┤
          ___             ___             &kp F5          &kp F6          &kp F7          &kp F8              &kp LEFT        &kp DOWN        &kp UP          &kp RIGHT       &mkp MB4        ___
     // ├───────────────┼───────────────┼───────────────┼───────────────┼───────────────┼───────────────┤   ├───────────────┼───────────────┼───────────────┼───────────────┼───────────────┼───────────────┤
          ___             ___             &kp F9          &kp F10         &kp F11         &kp F12             &kp HOME        &kp PG_DN       &kp PG_UP       &kp END         &mkp MB5        ___
     // ╰───────────────────────────────────────────────┼───────────────┼───────────────┼───────────────┤   ├───────────────┼───────────────┼───────────────┼───────────────────────────────────────────────╯
                                                          ___             ___             ___                 ___             ___             ___
     //                                                 ╰───────────────┴───────────────┴───────────────╯   ╰───────────────┴───────────────┴───────────────╯
)

ZMK_LAYER(ctl_layer,
     // ╭───────────────┬───────────────┬───────────────┬───────────────┬───────────────┬───────────────╮   ╭───────────────┬───────────────┬───────────────┬───────────────┬───────────────┬───────────────╮
          ___             ___             ___             ___             ___             ___                 ___             ___             ___             ___             ___             ___
     // ├───────────────┼───────────────┼───────────────┼───────────────┼───────────────┼───────────────┤   ├───────────────┼───────────────┼───────────────┼───────────────┼───────────────┼───────────────┤
          &bootloader     BT_CON(0)       BT_CON(1)       BT_CON(2)       BT_CON(3)       BT_CON(4)           RGB(RGB_HUI)    RGB(RGB_SAI)    RGB(RGB_BRI)    RGB(RGB_SPI)    RGB(RGB_EFF)    &bootloader
     // ├───────────────┼───────────────┼───────────────┼───────────────┼───────────────┼───────────────┤   ├───────────────┼───────────────┼───────────────┼───────────────┼───────────────┼───────────────┤
          &sys_reset      ___             POWER(EP_ON)    POWER(EP_OFF)   &out OUT_USB    &out OUT_BLE        RGB(RGB_HUD)    RGB(RGB_SAD)    RGB(RGB_BRD)    RGB(RGB_SPD)    RGB(RGB_TOG)    &sys_reset
     // ╰───────────────────────────────────────────────┼───────────────┼───────────────┼───────────────┤   ├───────────────┼───────────────┼───────────────┼───────────────────────────────────────────────╯
                                                          ___             ___             ___                 ___             ___             ___
     //                                                 ╰───────────────┴───────────────┴───────────────╯   ╰───────────────┴───────────────┴───────────────╯
)

ZMK_LAYER(game_layer,
     // ╭───────────────┬───────────────┬───────────────┬───────────────┬───────────────┬───────────────╮   ╭───────────────┬───────────────┬───────────────┬───────────────┬───────────────┬───────────────╮
          &kp TAB         &kp Q           &kp W           &kp E           &kp R           &kp T               &kp Y           &kp U           &kp I           &kp O           &kp P           &kp BACKSPACE
     // ├───────────────┼───────────────┼───────────────┼───────────────┼───────────────┼───────────────┤   ├───────────────┼───────────────┼───────────────┼───────────────┼───────────────┼───────────────┤
          &kp ESC         &kp A           &kp S           &kp D           &kp F           &kp G               &kp H           &kp J           &kp K           &kp L           &kp SEMI        &kp ENTER
     // ├───────────────┼───────────────┼───────────────┼───────────────┼───────────────┼───────────────┤   ├───────────────┼───────────────┼───────────────┼───────────────┼───────────────┼───────────────┤
          &kp LSHFT       &kp Z           &kp X           &kp C           &kp V           &kp B               &kp N           &kp M           &kp COMMA       &kp DOT         &kp SLASH       &kp LCTRL
     // ╰───────────────────────────────────────────────┼───────────────┼───────────────┼───────────────┤   ├───────────────┼───────────────┼───────────────┼───────────────────────────────────────────────╯
                                                          &kp LGUI        &kp BACKSLASH   &kp SPACE           &kp LBKT        &kp RBKT        &kp LALT
     //                                                 ╰───────────────┴───────────────┴───────────────╯   ╰───────────────┴───────────────┴───────────────╯
)

ZMK_LAYER(fighting_game_layer,
     // ╭───────────────┬───────────────┬───────────────┬───────────────┬───────────────┬───────────────╮   ╭───────────────┬───────────────┬───────────────┬───────────────┬───────────────┬───────────────╮
          &kp TAB         &kp T           &kp Q           &kp W           &kp E           &kp R               &kp Y           &kp U           &kp I           &kp O           &kp P           &kp BACKSPACE
     // ├───────────────┼───────────────┼───────────────┼───────────────┼───────────────┼───────────────┤   ├───────────────┼───────────────┼───────────────┼───────────────┼───────────────┼───────────────┤
          &kp ESC         &kp G           &kp A           &kp S           &kp D           &kp F               &kp H           &kp J           &kp K           &kp L           &kp SEMI        &kp ENTER
     // ├───────────────┼───────────────┼───────────────┼───────────────┼───────────────┼───────────────┤   ├───────────────┼───────────────┼───────────────┼───────────────┼───────────────┼───────────────┤
          &kp N1          &kp B           &kp Z           &kp X           &kp C           &kp V               &kp N           &kp M           &kp COMMA       &kp DOT         &kp SLASH       &kp N6
     // ╰───────────────┼───────────────────────────────────────────────┼───────────────┼───────────────┤   ├───────────────┼───────────────┼───────────────┼───────────────────────────────────────────────╯
                                                          &kp N2          &kp N3          &kp SPACE           &kp SPACE       &kp N4          &kp N5
     //                                                 ╰───────────────┴───────────────┴───────────────╯   ╰───────────────┴───────────────┴───────────────╯
)

// ZMK_LAYER(fighting_game_layer,
//       // ╭───────────────┬───────────────┬───────────────┬───────────────┬───────────────┬───────────────╮   ╭───────────────┬───────────────┬───────────────┬───────────────┬───────────────┬───────────────╮
//            ___             ___             ___             ___             ___             ___                 ___             ___             ___             ___             ___             ___
//       // ├───────────────┼───────────────┼───────────────┼───────────────┼───────────────┼───────────────┤   ├───────────────┼───────────────┼───────────────┼───────────────┼───────────────┼───────────────┤
//            ___             ___             ___             ___             ___             ___                 ___             ___             ___             ___             ___             ___
//       // ├───────────────┼───────────────┼───────────────┼───────────────┼───────────────┼───────────────┤   ├───────────────┼───────────────┼───────────────┼───────────────┼───────────────┼───────────────┤
//            ___             ___             ___             ___             ___             ___                 ___             ___             ___             ___             ___             ___
//       // ╰───────────────────────────────────────────────┼───────────────┼───────────────┼───────────────┤   ├───────────────┼───────────────┼───────────────┼───────────────────────────────────────────────╯
//                                                            ___             &kp E           &kp E               ___             ___             ___
//       //                                                 ╰───────────────┴───────────────┴───────────────╯   ╰───────────────┴───────────────┴───────────────╯
// )

// ZMK_LAYER(layer,
//      // ╭───────────────┬───────────────┬───────────────┬───────────────┬───────────────┬───────────────╮   ╭───────────────┬───────────────┬───────────────┬───────────────┬───────────────┬───────────────╮
//           ___             ___             ___             ___             ___             ___                 ___             ___             ___             ___             ___             ___
//      // ├───────────────┼───────────────┼───────────────┼───────────────┼───────────────┼───────────────┤   ├───────────────┼───────────────┼───────────────┼───────────────┼───────────────┼───────────────┤
//           ___             ___             ___             ___             ___             ___                 ___             ___             ___             ___             ___             ___
//      // ├───────────────┼───────────────┼───────────────┼───────────────┼───────────────┼───────────────┤   ├───────────────┼───────────────┼───────────────┼───────────────┼───────────────┼───────────────┤
//           ___             ___             ___             ___             ___             ___                 ___             ___             ___             ___             ___             ___
//      // ╰───────────────────────────────────────────────┼───────────────┼───────────────┼───────────────┤   ├───────────────┼───────────────┼───────────────┼───────────────────────────────────────────────╯
//                                                           ___             ___             ___                 ___             ___             ___
//      //                                                 ╰───────────────┴───────────────┴───────────────╯   ╰───────────────┴───────────────┴───────────────╯
// )
